## dts/bindings/misc/zephyr,ebus-serial.yaml
```yaml
# SPDX-License-Identifier: Apache-2.0

description: eBUS 2-wire digital serial data-bus communication interface

compatible: "zephyr,ebus-serial"

include: uart-device.yaml
```

## subsys/ebus/Kconfig
```kconfig
# SPDX-License-Identifier: Apache-2.0

menuconfig EBUS
    bool "eBUS support"
    select SERIAL
    select UART_USE_RUNTIME_CONFIGURE
    select UART_INTERRUPT_DRIVEN
if EBUS

config EBUS_UART_BUFFER_SIZE
        int "eBUS UART buffer size"
        default 32
        range 16 64
        help
          eBUS buffer size.

module = EBUS
module-str = Modbus Support
module-help = Sets log level for Modbus support
source "subsys/logging/Kconfig.template.log_config"

endif
```

## west.yml
```yaml
# SPDX-License-Identifier: Apache-2.0

# simplified manifest file

manifest:
  remotes:
    - name: zephyrproject-rtos
      url-base: https://github.com/zephyrproject-rtos
  projects:
    - name: zephyr
      remote: zephyrproject-rtos
      revision: v4.1.0
      import:
        name-allowlist:
          - cmsis
          - fatfs
          - hal_nxp
          - mbedtls
          - mcuboot
          - mcumgr
          - segger
          - tinycbor
          - tinycrypt
          - zcbor
  self:
    path: application
```
